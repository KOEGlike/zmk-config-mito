## boards/arm/mito/Kconfig
```kconfig
config BOARD_ENABLE_DCDC
    bool "Enable DCDC mode"
    select SOC_DCDC_NRF52X
    default y
    depends on (BOARD_MITO_LH || BOARD_MITO_RH)
```

## boards/arm/mito/Kconfig.board
```kconfig
# Copyright (c) 2021 Nick Winans
# SPDX-License-Identifier: MIT

config BOARD_MITO_LEFT
    bool "Mito LEFT"
    depends on SOC_NRF52833_QIAA

config BOARD_MITO_RIGHT
    bool "Mito RIGHT"
    depends on SOC_NRF52833_QIAA
```

## boards/arm/mito/Kconfig.defconfig
```kconfig
if BOARD_MITO_LEFT

config BOARD
    default "mito left"

config ZMK_SPLIT_BLE_ROLE_CENTRAL
    default y

endif # BOARD_MITO_LEFT

if BOARD_MITO_RIGHT

config BOARD
    default "mito right"

endif # BOARD_MITO_RIGHT

if BOARD_MITO_LEFT || BOARD_MITO_RIGHT

config ZMK_SPLIT
    default y

config BT_CTLR
    default BT

config ZMK_KSCAN_MATRIX_WAIT_BETWEEN_OUTPUTS
    default 5

config PINCTRL
    default y

if USB

config USB_NRFX
    default y

config USB_DEVICE_STACK
    default y

endif # USB

if ZMK_BACKLIGHT

config PWM
    default y

config LED_PWM
    default y

endif # ZMK_BACKLIGHT

if ZMK_RGB_UNDERGLOW

config SPI
    default y

config WS2812_STRIP
    default y

endif # ZMK_RGB_UNDERGLOW

endif # BOARD_MITO_LEFT || BOARD_MITO_RIGHT
```

## boards/shields/mito/Kconfig.defconfig
```kconfig
if SHIELD_NICETRY_LEFT
  
config ZMK_KEYBOARD_NAME
    default "tboard"

config ZMK_SPLIT_ROLE_CENTRAL
    default y

endif

if SHIELD_MITO_LEFT || SHIELD_MITO_RIGHT

config ZMK_SPLIT
    default y

endif
```

## boards/shields/mito/Kconfig.shield
```kconfig
config SHIELD_MITO_LEFT
    def_bool $(shields_list_contains,mito_left)

config SHIELD_MITO_RIGHT
    def_bool $(shields_list_contains,mito_right)
```
